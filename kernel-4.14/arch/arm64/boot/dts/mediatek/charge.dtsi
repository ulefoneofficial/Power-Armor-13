
&i2c8 {
	fuelguage@62 {
		compatible = "cellwise,cw2015";
		reg = <0x62>;
		batinfo = /bits/ 8 <0x18 0x0A 0x80 0x71 0x6D 0x6C 0x69 0x68 0x5E 0x6D 0x55 0x57 0x59 0x5A 0x4C 0x3E 0x31 0x27 0x20
                            0x19 0x1A 0x29 0x41 0x4A 0x2E 0x35 0x0B 0x85 0x22 0x43 0x44 0x4A 0x55 0x58 0x5A 0x5A 0x3C 0x1A
                            0x67 0x44 0x0B 0x20 0x43 0x71 0x8C 0x91 0x91 0x19 0x4E 0x84 0x93 0x9C 0x80 0x3B 0x61 0xCB 0x2F
                            0x00 0x64 0xA5 0xB5 0x0E 0x09 0x99>;
	};
};