## kernel-4.14/drivers/misc/mediatek/prize/dual_camera_als/Kconfig
```kconfig
config PRIZE_DUAL_CAMERA_ALS_ENABLE
	bool "Support prize_dual_camera_als function"
	default n
	help
		 Select Y to enable prize_dual_camera_als function
		 
config PRIZE_DUAL_CAMERA_ALS_REAR
	bool "Support prize_dual_camera_als rear function"
	default n
	select PRIZE_DUAL_CAMERA_ALS
	help
		Select Y to enable prize_dual_camera_als function
		 
config PRIZE_DUAL_CAMERA_ALS_FRONT
	bool "Support prize_dual_camera_als front function"
	default n
	select PRIZE_DUAL_CAMERA_ALS
	help
		Select Y to enable prize_dual_camera_als function
```

## kernel-4.14/drivers/misc/mediatek/prize/exergen/Kconfig
```kconfig
#liaojie prize exergen 20210128 start
config PRIZE_EXERGEN
        tristate "prize exergen for Mediatek package"
        default n
        help
          Say y here if you have prize exergen.
          If unsure, say N.
#liaojie prize exergen 20210128 end
#liaojie prize exergen 20210128 start
config EXERGEN_FM78100
        tristate "prize exergen fm78100 for Mediatek package"
        default n
        help
          Say y here if you have prize exergen.
          If unsure, say N.
#liaojie prize exergen 20210128 end
```

## kernel-4.14/drivers/misc/mediatek/prize/ir_camera_motor/Kconfig
```kconfig
config PRIZE_IR_CAMERA_MOTOR
	bool "IR Camera Motor"
	default n
	help
	  prize ir camera motor driver
```

## kernel-4.14/drivers/misc/mediatek/prize/laser_light_gpio/Kconfig
```kconfig
config PRIZE_LASER_LIGHT_GPIO
	bool "Support prize_laser_light_gpio function"
	default n
	help
		 Select Y to enable prize_laser_light_gpio function
```

## kernel-4.14/drivers/misc/mediatek/prize/lcd_bias/Kconfig
```kconfig
config PRIZE_LCD_BIAS
  bool "prize lcd bias"
  default n
  help
    lcd bias driver.

config PRIZE_TPS65132_SUPPORT
  bool "prize tps65132"
  default n
  select PRIZE_LCD_BIAS
  help
    tps65132 bias driver.
```

## kernel-4.14/drivers/misc/mediatek/prize/tm1621d/Kconfig
```kconfig
config PRIZE_DIGITAL_LCD_TM1621D
  bool "prize digital lcd"
  default n
  help
     digital lcd driver.
```

## kernel-4.14/drivers/misc/mediatek/sensor/2.0/mtk_nanohub/Kconfig
```kconfig
config NANOHUB
	tristate "Nanohub"
	default N
	help
	  Enable support for the nanohub sensorhub driver.
	  This driver supports the android nanohub sensorhub.

	  If in doubt, say N here.
# begin, prize-lifenfen-20181126, add for sensorhub hardware info
config SENSORHUB_PRIZE_HARDWARE_INFO
	depends on NANOHUB
        bool "SENSORHUB PRIZE HARDWARE INFO support"
        help
          Kernel space sensor hub driver hardware info.

config SENSORHUB_PRIZE_HARDWARE_INFO_SIZE
        depends on NANOHUB
        bool "SENSORHUB PRIZE HARDWARE INFO SIZE support"
        help
          Kernel space sensor hub driver hardware info size.
# end, prize-lifenfen-20181126, add for sensorhub hardware info
source "drivers/misc/mediatek/sensor/2.0/mtk_nanohub/nanohub/Kconfig"
```

## kernel-4.14/drivers/nfc/nxp533/Kconfig
```kconfig
config MANUFACTOR_NFC_NXP533
	tristate "NXP PN533 NFC driver"
	depends on I2C
	default n
	---help---
	  NXP PN547 core driver.
	  This is a driver based on the HCI NFC kernel layers and
	  will thus not work with NXP libnfc library.

config REGIGISTER_DYNAMIC
	tristate "Dynamic register device"
	default n
	help
	Say yes if you want Dynamic register device according to whether the chip is work in PN547 NFC driver.
	This is by means of i2c connected communication with chip.
```

## kernel-4.14/drivers/power/supply/mediatek/battery/Kconfig
```kconfig
menuconfig MEDIATEK_BATTERY_SOLUTION
	bool "MediaTek Propritary Configuration for Battery"
	help
	  Check this to enable MediaTek Battery configuration.

config MTK_SMART_BATTERY
	bool "MediaTek Smart Battery Driver"
	help
	  Check this to enable MediaTek smart battery driver.
	  The driver supports charging control flow.
	  It maintais both charger and battery status.
	  It also includes Mediatek gas gauge.

config MTK_GAUGE_VERSION
	int "MediaTek Fuel Gauge version"
	default 20
	help
	  Select MTK Gauge Master version
	  30: Gauge Master 3.0

#prize added by huarui, cw2015 support, 20190111-start
config MTK_CW2015_SUPPORT
	bool "Charger Driver for CW2015 fg"
	default n
	help
	  Say Y to enable
	  CW2015 driver.
	  It depends on config MTK_SMART_BATTERY
	  and config MTK_SWCHR_SUPPORT.
	  
config MTK_CW2015_SUPPORT_OF
	bool "Charger Driver for CW2015 fg"
	default n
	select MTK_CW2015_SUPPORT
	help
	  Say Y to enable CW2015 driver.
#prize added by huarui, cw2015 support, 20190111-end
	  
config MTK_DISABLE_GAUGE
	bool "disable Gauge Master 3.0"
	default n
	help
	  Set Yes to disable Gauge Master 3.0
	  under new MTK Charger Framework
	  Set No to enable Gauge Master 3.0
	  under new MTK Charger Framework

config MTK_ADDITIONAL_BATTERY_TABLE
	bool "Enable the fifth battery table"
	default y
	help
	  Set Yes to enable the fifth battery table
	  Table number is five.
	  Set No to disable the fifth battery table
	  Table number is four.
	  
config PRIZE_ZERO_PERCENT_POWER_OFF
     bool "zero percent power off"
	  default n
	 help
	  Say Y to enable
	  power off driver.
	  It depends on config MTK_SMART_BATTERY
	  and config MTK_SWCHR_SUPPORT.
```
