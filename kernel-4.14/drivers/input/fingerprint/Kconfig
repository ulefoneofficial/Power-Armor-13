## kernel-4.14/drivers/input/fingerprint/Kconfig
```kconfig
#
#Fingerprint
#
menu "Fingerprint support"
	depends on INPUT

config MTK_FINGERPRINT_SUPPORT
	bool "Mediatek Fingerprint"
	default n
	help
	  Fingerprint mtk driver enable/disable
	  in the kernel.Say Y here if you want to
	  use mediatek fingerprint driver,fingerprint
	  driver will support fingerprint function

if MTK_FINGERPRINT_SUPPORT
config MTK_FINGERPRINT_SELECT
	string "sensor type"
	default "GF318M"

config MTK_FINGERPRINT_SUPPORT_LIST
	string "sensor type"
    help
      Set touch IC name if you have touch panel.

      To compile this dirver for used touch IC.

if MTK_FINGERPRINT_SELECT = "FPC1145"
config FPC_FINGERPRINT
	bool "FPC Fingerprint"
	default y
	help
	  FPC fingerprint FPC's 102x/104x device.
endif

if MTK_FINGERPRINT_SELECT = "GF318M" ||  MTK_FINGERPRINT_SELECT = "GF5216"
config GOODIX_FINGERPRINT
	bool "Goodix Fingerprint"
#prize modify by mhy start
	default n
#prize modify by mhy end
	help
	  Goodix Fingerprint chip GF316M/GF318M/
	  GF3118M/GF518M/GF5118M/GF516M/GF816M/
	  GF3208/GF3206/GF3266/GF3288/GF5206/
	  GF5216/GF5208 TEE driver

config GOODIX_SENSOR_TYPE
	string "SENSOR_TYPE"
	default "GF5216"
	help
	  Must input sensor type, or default is
	  GF316M GF318M GF3118M GF518M GF5118M
	  GF516M GF816M GF3208 GF3206 GF3266
	  GF3288 GF5206 GF5216 GF5208
endif
# begin, prize-pengguangyi-20190121, add for goodix gf5118m fp
config GOODIX_GF5118M_FINGERPRINT
	bool "Goodix GF5118M Fingerprint"
	default n
	---help---
	Goodix Fingerprint chip GF316M/GF318M/GF3118M/GF518M/GF5118M/GF516M/GF816M/GF3208/GF3206/GF3266/GF3288/GF5206 TEE driver
# end, prize-pengguangyi-20190121, add for goodix gf5118m fp

#prize-add-pengzhipeng-20191105-start
if MTK_FINGERPRINT_SELECT = "ft9362"
  config FT9362_FINGERPRINT
     bool "FT9362 Fingerprint"
     default y
     ---help---
     MICROARRAY fingerprint FT9362's device.
endif

if MTK_FINGERPRINT_SELECT = "ft9362_tee"
  config FT9362_FINGERPRINT_TEE
     bool "FT9362 TEE Fingerprint"
     default y
     ---help---
     MICROARRAY fingerprint FT9362 TEE's device.
endif
if MTK_FINGERPRINT_SELECT = "sunwave_driver_all_in_one"
  config MTK_FINGERPRINT_SUNWAVECORP
       bool "Sunwave Fingerprint"
       default y
	---help---
     MICROARRAY fingerprint Sunwave's device.
endif
#prize-add-pengzhipeng-20191105-end

#prize added by huarui, add fp driver, 20190327-start
if MTK_FINGERPRINT_SELECT = "chipone_ree"
config CHIPONE_FINGERPRINT_REE
	bool "CHIPONE Fingerprint"
	default y
	help
	  CHIPONE fingerprint CHIPONE's device.
endif
#prize added by huarui, add tp driver, 20190327-end
#prize-add finger-tangcong-20200715-start
if MTK_FINGERPRINT_SELECT = "betterlife_tee"
config BETTERLIFE_FINGERPRINT
    bool "betterlife Fingerprint"
	default y
	---help---
	betterlife fingerprint.
endif
#prize-add finger-tangcong-20200715-end

#prize add by lipengpeng 20200628 start
if MTK_FINGERPRINT_SELECT = "chipone_tee"
config CHIPONE_FINGERPRINT_TEE
	bool "CHIPONE Fingerprint"
	default y
	help
	  CHIPONE fingerprint CHIPONE's device.
endif
#prize add by lipengpeng 20200628 end


endif
#prize added by huarui, add fp driver, 20190327-start
config PRIZE_FP_USE_VFP
	bool "Fingerprint power vfp"
	default n
	help
	  CHIPONE fingerprint CHIPONE's device.
#prize added by huarui, add tp driver, 20190327-end

#prize-add finger-wangyongsheng-20210204-start
if MTK_FINGERPRINT_SELECT = "cdfinger_ree"
config CDFINGER_REE
    bool "cdfinger Fingerprint"
	default y
	---help---
	cdfinger fingerprint.
endif
#prize-add finger-wangyongsheng-20210204-end

if MTK_FINGERPRINT_SELECT = "fortsense_ree"
config MTK_FINGERPRINT_FORTSENSE
    bool "cdfinger Fingerprint"
	default y
	---help---
	cdfinger fingerprint.
endif

#prize added by chenjiaxi, fortsense fingerprint, 20210410-start
if MTK_FINGERPRINT_SELECT = "fortsense_real_ree"
  config MTK_FINGERPRINT_FORTSENSE_REAL_REE
       bool "Fortsense Fingerprint"
       default y
	---help---
     fortsense fingerprint Fortsense's device.
endif
#prize added by chenjiaxi, fortsense fingerprint, 20210410-end


#prize-add finger-wangyongsheng-20210327-start
if MTK_FINGERPRINT_SELECT = "microarray_fp"
config MICROARRAY_FP
    bool "microarray Fingerprint"
	default y
	---help---
	microarray fingerprint.
endif
#prize-add finger-wangyongsheng-20210327-end

endmenu
```

## kernel-4.14/drivers/input/fingerprint/chipone_tee/Kconfig
```kconfig
config MTK_FINGERPRINT
        tristate "Chipone fpsensor Finger Print Driver"
        default n
        help
          Chipone Finger Print Supported
```

## kernel-4.14/drivers/input/touchscreen/tlsc6x/Kconfig
```kconfig
#
# Focaltech Touchscreen driver configuration
#

config TOUCHSCREEN_FTS
    bool "tlsc6x Touchscreen"
    default n
    help
      Say Y here if you have tlsc6x touch panel.
      If unsure, say N.
      
config TOUCHSCREEN_FTS_DIRECTORY
    string "tlsc6x ts directory name"
    default "focaltech_touch"
    depends on TOUCHSCREEN_FTS
    
```

## kernel-4.14/drivers/misc/mediatek/flashlight/Kconfig
```kconfig
#
# Flashlight device configuration
#

config MTK_FLASHLIGHT
	tristate "Mediatek flashlight driver"
	help
	  This is flashlight driver for camera.

	  Say Y here if you want a flashlight core to handle flashlight devices.
	  If you have any questions about this, say Y here, only say N
	  if you know exactly what you are doing.

config MTK_V4L2_FLASHLIGHT
	bool "Mediatek V4L2 flashlight driver"
	help
	  Say Y to enable V4L2 flashlight device
	  This Framework is good for
	  controling flashlight Leds.
	  Say N to disable V4L2 flashlight.

config MTK_FLASHLIGHT_LED191
	tristate "Mediatek flashlight led191 gpio driver"
	depends on MTK_FLASHLIGHT
	help
	  This is flashlight led191 gpio driver for camera.

	  Say Y here if you want a driver IC with GPIO interface.
	  Select this only if your board has this IC.

	  Say M here if you want to compile this driver as a module.

config MTK_FLASHLIGHT_LM3642
	tristate "Mediatek flashlight with driver IC (TI LM3642)"
	depends on MTK_FLASHLIGHT
	help
	  This is for the flashlight driver IC (TI LM3642).

	  Say Y here if you want a flashlight driver IC LM3642.
	  Select this only if your board has this IC.

	  Say M here if you want to compile this driver as a module.

config MTK_FLASHLIGHT_LM3643
	tristate "Mediatek flashlight with driver IC (TI LM3643)"
	depends on MTK_FLASHLIGHT
	help
	  This is for the flashlight driver IC (TI LM3643).

	  Say Y here if you want a flashlight driver IC LM3643.
	  Select this only if your board has this IC.

	  Say M here if you want to compile this driver as a module.

config MTK_FLASHLIGHT_LM3644
	tristate "Mediatek flashlight with driver IC (TI LM3644)"
	depends on MTK_FLASHLIGHT
	help
	  This is for the flashlight driver IC (TI LM3644).

	  Say Y here if you want a flashlight driver IC LM3644.
	  Select this only if your board has this IC.

	  Say M here if you want to compile this driver as a module.

config MTK_FLASHLIGHT_RT4505
	tristate "Mediatek flashlight with driver IC (Richtek RT4505)"
	depends on MTK_FLASHLIGHT
	help
	  This is for the flashlight driver IC (Richtek RT4505).

	  Say Y here if you want a flashlight driver IC RT4505.
	  Select this only if your board has this IC.

	  Say M here if you want to compile this driver as a module.

config MTK_FLASHLIGHT_RT5081
	tristate "Mediatek flashlight with driver IC (Richtek RT5081)"
	depends on MTK_FLASHLIGHT && RT_FLASHLIGHT
	help
	  This is for the flashlight driver IC (Richtek RT5081).

	  Say Y here if you want a flashlight driver IC RT5081.
	  Select this only if your board has this IC.

	  Say M here if you want to compile this driver as a module.

config MTK_FLASHLIGHT_MT6336
	tristate "Mediatek flashlight with driver IC (Mediatek MT6336)"
	depends on MTK_FLASHLIGHT
	help
	  This is for the flashlight driver IC (Mediatek MT6336).

	  Say Y here if you want a flashlight driver IC MT6336.
	  Select this only if your board has this IC.

	  Say M here if you want to compile this driver as a module.

config MTK_FLASHLIGHT_MT6370
	tristate "Mediatek flashlight with driver IC (Mediatek MT6370)"
	depends on MTK_FLASHLIGHT && RT_FLASHLIGHT
	help
	  This is for the flashlight driver IC (Mediatek MT6370).

	  Say Y here if you want a flashlight driver IC MT6370.
	  Select this only if your board has this IC.

	  Say M here if you want to compile this driver as a module.

config MTK_FLASHLIGHT_MT6360
	tristate "Mediatek flashlight with driver IC (Mediatek MT6360)"
	depends on MTK_FLASHLIGHT && RT_FLASHLIGHT
	help
	  This is for the flashlight driver IC (Mediatek MT6360).

	  Say Y here if you want a flashlight driver IC MT6360.
	  Select this only if your board has this IC.

	  Say M here if you want to compile this driver as a module.

config MTK_FLASHLIGHT_DUMMY
	tristate "Mediatek flashlight dummy driver"
	depends on MTK_FLASHLIGHT
	help
	  This is flashlight dummy driver for camera.

	  Say Y here if you want a dummy driver IC with I2C interface.
	  Select this only if your board has this IC.

	  Say M here if you want to compile this driver as a module.

config MTK_FLASHLIGHT_DUMMY_GPIO
	tristate "Mediatek flashlight dummy gpio driver"
	depends on MTK_FLASHLIGHT
	help
	  This is flashlight dummy gpio driver for camera.

	  Say Y here if you want a dummy driver IC with GPIO interface.
	  Select this only if your board has this IC.

	  Say M here if you want to compile this driver as a module.

config MTK_FLASHLIGHT_DEBUG
	bool "Mediatek flashlight debugging messages"
	depends on MTK_FLASHLIGHT
	help
	  Say Y here if you want the flashlight to produce a bunch of debug
	  messages to the system log.

	  Select this if you are having a problem with flashlight support
	  and want to see more of what is going on.

config MTK_FLASHLIGHT_PT
	bool "Mediatek flashlight power throttling"
	depends on MTK_FLASHLIGHT
	help
	  This is for flashlight power throttling.

	  Power throttling will limit flashlight function,
	  such as disable flashlight, decrease brightness level or
	  change flash mode to torch mode.

config MTK_FLASHLIGHT_PT_STRICT
    bool "Mediatek flashlight power throttling (strict)"
	depends on MTK_FLASHLIGHT_PT
	help
	  This is for flashlight strict power throttling.

	  Strict power throttling will disable flashlight when
	  over-current, low battary voltage and low battary percentage
	  situations.

config MTK_FLASHLIGHT_DLPT
    bool "Mediatek flashlight dynamic low power throttling"
	depends on MTK_FLASHLIGHT
	help
	  This is for flashlight dynamic low power throttling.

	  Dynamic low power throttling is a mechanism to monitor
	  the current of battary dynamicly. It will start by request
	  and notice user by kernel notifier.
#/*zhengjiang.zhu@prize.Camera.Driver  20200116  start for sub_flash_aw36402*/
config MTK_FLASHLIGHT_AW36402_GPIO
	tristate "Mediatek flashlight aw36402 gpio driver"
	depends on MTK_FLASHLIGHT
	default n
	help
	  This is flashlight aw36402 gpio driver for camera.

	  Say Y here if you want a aw36402 driver IC with GPIO interface.
	  Select this only if your board has this IC.

	  Say M here if you want to compile this driver as a module.
#/*zhengjiang.zhu@prize.Camera.Driver  20200116  end for sub_flash_aw36402*/
#/*zhengjiang.zhu@prize.Camera.Driver  20200904  start for flash_aw36518*/
config MTK_FLASHLIGHT_AW36518
	tristate "Mediatek flashlight isink driver"
	depends on MTK_FLASHLIGHT
	default n
	help
		This is flashlight isink gpio driver for camera.
#/*zhengjiang.zhu@prize.Camera.Driver  20200116  end for sub_flash_aw36402*/
#prize add by lipengpeng 20210208 start 
config MTK_FLASHLIGHT_SGM37895
	tristate "Mediatek flashlight isink driver"
	depends on MTK_FLASHLIGHT
	default n
	help
		This is flashlight isink gpio driver for camera.
config MTK_FLASHLIGHT_SGM37895A
	tristate "Mediatek flashlight isink driver"
	depends on MTK_FLASHLIGHT
	default n
	help
		This is flashlight isink gpio driver for camera.
		
config PRIZE_FLASH_HW_TOUCH
	tristate "Mediatek flashlight hw touch driver"
	depends on MTK_FLASHLIGHT
	default n
	help
		This is flashlight isink gpio driver for camera.
#prize add by lipengpeng 20210208 end 
```

## kernel-4.14/drivers/misc/mediatek/prize/Kconfig
```kconfig
config PRIZE_LCD_BIAS
  bool CONFIG_PRIZE_LCD_BIAS
  default no
  help
    CONFIG_PRIZE_LCD_BIAS

# prize-dingjun-20150410-start
config PRIZE_HALL
	bool "hall device"
	default n
	help
	  Select Y to enable hall device support
# prize-dingjun-20150410-end

#prize add by huarui, sos torch , 20200402 start
config PRIZE_TORCH
	bool "torch with fun"
	default n
	help
	  Select Y to enable prize torch
#prize add by huarui, sos torch , 20200402 start

# prize-huangjiwu-20201217-start
config PRIZE_BAT_DET
	bool "bat det device"
	default n
	help
	  Select Y to enable bat det device support
# prize-huangjiwu-20201217-end
#prize add by huarui, hoperf hp5804 , 20200402 start
config PRIZE_BAROMETER_H5804
	bool "water barometer with h5804"
	default n
	help
	  Select Y to enable water barometer
#prize add by huarui, hoperf hp5804 , 20200402 start

#prize add by huangjiwu, fm ant , 20200720 start
config PRIZE_FM_ANT_SWITCH
	bool "fm ant switch fun"
	default n
	help
	  Select Y to enable prize fm ant switch fun
#prize add by huarui, fm ant switch , 20200720 start

#prize added by chenjiaxi, prize_dual_camera driver, 20190111-start
source "drivers/misc/mediatek/prize/dual_camera/Kconfig"
#prize added by chenjiaxi, prize_dual_camera driver, 20190111-end

#prize added by chenjiaxi, prize_dual_camera_als driver, 20200922-start
source "drivers/misc/mediatek/prize/dual_camera_als/Kconfig"
#prize added by chenjiaxi, prize_dual_camera_als driver, 20200922-end

#prize add by huarui, haptic drv , 20200402 start
config PRIZE_HAPTIC_AW8695
	tristate "haptic drv IC driver"
	default n
	depends on !MTK_VIBRATOR
	  ---help---
	  Vibrator driver support for MediaTek SOC.
#prize add by huarui, haptic drv , 20200402 start

#prize-add prize-wangyunqing-20181110-start
#source "drivers/misc/mediatek/prize/hardware_info/Kconfig"
#prize-add prize-wangyunqing-20181110-end

#prize-add prize-zhaopengge-20200915-start
source "drivers/misc/mediatek/prize/aw2028_led/Kconfig"
source "drivers/misc/mediatek/prize/aw2015/Kconfig"
source "drivers/misc/mediatek/prize/aw2016a/Kconfig"
#prize-add prize-zhaopengge-20200915-end

#prize added by chenjiaxi, ir camera motor drv, 20201117-start
source "drivers/misc/mediatek/prize/ir_camera_motor/Kconfig"
#prize added by chenjiaxi, ir camera motor drv, 20201117-end

source "drivers/misc/mediatek/prize/lcd_bias/Kconfig"

#prize add by zhaopengge-20210630-start
source "drivers/misc/mediatek/prize/tm1621d/Kconfig"
#prize add by zhaopengge-20210630-start

#prize add by lipengpeng 20210220 start 

config PRIZE_AIR_QUALITY
	bool "air quality enable"
	default n
	help
	  Select Y to enable prize air qualit enable
#prize add by lipengpeng 20210220 end 


#prize add by liaojie, prize_exergen build support 20210128 start
source "drivers/misc/mediatek/prize/exergen/Kconfig"
#prize add by liaojie, prize_exergen build support 20210128 end

#prize added by chenjiaxi, laser light gpio, 20210108-start
source "drivers/misc/mediatek/prize/laser_light_gpio/Kconfig"
#prize added by chenjiaxi, laser light gpio, 20210108-end
```

## kernel-4.14/drivers/misc/mediatek/prize/aw2015/Kconfig
```kconfig
config PRIZE_LEDS_AW2015
	tristate "LED Support for AW2015"
	depends on LEDS_CLASS && I2C
	help
		this option enables support for the AW2015 RGB LED connected
		through I2C. Say Y to enable support for the AW2015 LED
```

## kernel-4.14/drivers/misc/mediatek/prize/aw2016a/Kconfig
```kconfig
config PRIZE_LEDS_AW2016
	tristate "LED Support for AW2016"
	help
		this option enables support for the AW2016 RGB LED connected
		through I2C. Say Y to enable support for the AW2016 LED
```

## kernel-4.14/drivers/misc/mediatek/prize/aw2028_led/Kconfig
```kconfig
config PRIZE_LED_AW2028
	bool "IRLED AW36515 "
	default n
	help
	  prize led aw2028 driver
```
